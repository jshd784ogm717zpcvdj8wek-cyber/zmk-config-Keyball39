## west.yml
```yaml
manifest:
  remotes:
    - name: zmk
      url-base: https://github.com/zmkfirmware
    - name: pmw3610
    
      url-base: https://github.com/<jshd784ogm717zpcvdj8wek-cyber>

  projects:
    - name: zmk
      remote: zmk
      revision: main
      import: app/west.yml

    - name: zmk-pmw3610-driver
      remote: pmw3610
      revision: main
      path: zmk-pmw3610-driver

  self:
    path: .
```
